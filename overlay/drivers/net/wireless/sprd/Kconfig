## overlay/drivers/net/wireless/sprd/Kconfig
```kconfig
# SPDX-License-Identifier: GPL-2.0-only
config WLAN_VENDOR_SPRD
	bool "Spreadtrum / Unisoc wireless devices"
	default y
	help
	  If you have a Spreadtrum/Unisoc wireless card belonging to this class,
	  say Y.

if WLAN_VENDOR_SPRD

source "drivers/net/wireless/sprd/sc2331/Kconfig"

endif # WLAN_VENDOR_SPRD
```

## overlay/drivers/net/wireless/sprd/sc2331/Kconfig
```kconfig
# SPDX-License-Identifier: GPL-2.0-only
config SPRD_SC2331
	tristate "Spreadtrum SC2331 (Marlin 1) SDIO Wi-Fi support"
	depends on CFG80211 && MMC && SERIAL_DEV_BUS
	select FW_LOADER
	help
	  Driver for the Spreadtrum SC2331 ("Marlin 1") Wi-Fi/BT combo chip
	  using UART0 Stage-1 FDL download and SDIO Stage-2 firmware/WLAN
	  transport.
```

## source/j1mini_defconfig
```kconfig
CONFIG_LOCALVERSION="-j1mini"
# CONFIG_LOCALVERSION_AUTO is not set
CONFIG_SYSVIPC=y
CONFIG_NO_HZ_IDLE=y
CONFIG_HIGH_RES_TIMERS=y
CONFIG_PREEMPT=y
CONFIG_IKCONFIG=y
CONFIG_IKCONFIG_PROC=y
# CONFIG_UTS_NS is not set
# CONFIG_TIME_NS is not set
# CONFIG_PID_NS is not set
CONFIG_BLK_DEV_INITRD=y
CONFIG_INITRAMFS_SOURCE="/work/gtelwifi-mainline/buildkit/initramfs.local"
CONFIG_ARCH_SPRD=y
CONFIG_SPRD_BOOTSTRIPES=y
CONFIG_SPRD_USB_BRINGUP=y
CONFIG_SPRD_RESTART=y
CONFIG_SPRD_CLK_CPU=y
CONFIG_SPRD_SC2723_DCDC_ARM=y
CONFIG_SPRD_CLK_AUX0=y
CONFIG_SPRD_CLK_GATES=y
CONFIG_SPRD_SC2723_LDO=y
CONFIG_SPRD_SC7730_PM_DOMAINS=y
CONFIG_SPRD_CPROC=y
CONFIG_SPRD_SIPC=y
CONFIG_SPRD_SC2723_PMIC=y
CONFIG_SPRD_SC2723_ADC=y
CONFIG_SPRD_SC2723_FGU=y
CONFIG_ARM_ERRATA_814220=y
CONFIG_SMP=y
CONFIG_HZ_250=y
CONFIG_THUMB2_KERNEL=y
CONFIG_HIGHMEM=y
CONFIG_CMDLINE="console=tty0 printk.devkmsg=on vt.global_cursor_default=0 ignore_loglevel panic=10 printk.time=1 fbcon=font:VGA8x16"
CONFIG_CMDLINE_EXTEND=y
CONFIG_VFP=y
CONFIG_NEON=y
CONFIG_PM_DEBUG=y
# CONFIG_SECCOMP is not set
# CONFIG_STACKPROTECTOR is not set
# CONFIG_BLOCK_LEGACY_AUTOLOAD is not set
CONFIG_PARTITION_ADVANCED=y
# CONFIG_MQ_IOSCHED_DEADLINE is not set
# CONFIG_MQ_IOSCHED_KYBER is not set
# CONFIG_IOSCHED_BFQ is not set
# CONFIG_SLAB_MERGE_DEFAULT is not set
# CONFIG_COMPAT_BRK is not set
CONFIG_CMA=y
CONFIG_PACKET=y
CONFIG_UNIX=y
CONFIG_INET=y
CONFIG_BT=y
CONFIG_BT_HCIUART=y
CONFIG_BT_HCIUART_BCM=y
CONFIG_CFG80211=y
CONFIG_DEVTMPFS=y
# CONFIG_STANDALONE is not set
# CONFIG_PREVENT_FIRMWARE_BUILD is not set
CONFIG_FW_LOADER_COMPRESS=y
CONFIG_FW_LOADER_COMPRESS_ZSTD=y
CONFIG_BLK_DEV_LOOP=y
CONFIG_NETDEVICES=y
CONFIG_INPUT_EVDEV=y
CONFIG_KEYBOARD_GPIO=y
CONFIG_KEYBOARD_SPRD_SC8830=y
# CONFIG_INPUT_MOUSE is not set
CONFIG_INPUT_TOUCHSCREEN=y
CONFIG_TOUCHSCREEN_MELFAS_MIP4=y
CONFIG_TOUCHSCREEN_EDT_FT5X06=y
CONFIG_TOUCHSCREEN_ZINITIX=y
# CONFIG_LEGACY_PTYS is not set
# CONFIG_LEGACY_TIOCSTI is not set
# CONFIG_LDISC_AUTOLOAD is not set
CONFIG_SERIAL_SPRD=y
CONFIG_SERIAL_SPRD_CONSOLE=y
CONFIG_SERIAL_DEV_BUS=y
# CONFIG_HW_RANDOM is not set
# CONFIG_DEVPORT is not set
CONFIG_I2C_CHARDEV=y
CONFIG_I2C_GPIO=y
CONFIG_I2C_SPRD_SC8830=y
CONFIG_GPIOLIB=y
CONFIG_GPIO_SPRD=y
CONFIG_GPIO_PMIC_EIC_SPRD=y
CONFIG_POWER_SUPPLY=y
CONFIG_CHARGER_SMB347=y
# CONFIG_HWMON is not set
CONFIG_THERMAL=y
CONFIG_CPU_THERMAL=y
CONFIG_SPRD_SC7730_THERMAL=y
CONFIG_REGULATOR=y
CONFIG_REGULATOR_FIXED_VOLTAGE=y
CONFIG_REGULATOR_USERSPACE_CONSUMER=y
CONFIG_MEDIA_SUPPORT=y
CONFIG_MEDIA_CAMERA_SUPPORT=y
CONFIG_MEDIA_PLATFORM_SUPPORT=y
CONFIG_V4L_PLATFORM_DRIVERS=y
CONFIG_VIDEO_SC7730_DCAM=y
CONFIG_VIDEO_SC7730_VSP=y
CONFIG_VIDEO_S5K4ECGX=y
CONFIG_VIDEO_SR200PC20M=y
CONFIG_DRM=y
CONFIG_DRM_LIMA=y
CONFIG_DRM_SPRD_DISPC=y
CONFIG_DRM_SIMPLEDRM=y
CONFIG_FB=y
CONFIG_BACKLIGHT_CLASS_DEVICE=y
CONFIG_BACKLIGHT_PWM=y
CONFIG_FRAMEBUFFER_CONSOLE_ROTATION=y
CONFIG_SOUND=y
CONFIG_SND=y
CONFIG_SND_SOC=y
CONFIG_SND_SOC_SPRD=y
CONFIG_SND_SOC_SPRD_VBC_SC7730=y
CONFIG_SND_SOC_SC2723=y
CONFIG_SND_SIMPLE_CARD=y
# CONFIG_HID_SUPPORT is not set
CONFIG_USB_DWC2=y
CONFIG_USB_GADGET=y
CONFIG_USB_CONFIGFS=y
CONFIG_USB_CONFIGFS_ACM=y
CONFIG_USB_CONFIGFS_NCM=y
CONFIG_USB_CONFIGFS_ECM=y
CONFIG_MMC=y
CONFIG_MMC_BLOCK_MINORS=32
CONFIG_MMC_SDHCI=y
CONFIG_MMC_SDHCI_PLTFM=y
CONFIG_MMC_SDHCI_SC7730=y
CONFIG_RTC_CLASS=y
CONFIG_RTC_DRV_SC27XX=y
CONFIG_DMADEVICES=y
CONFIG_SPRD_DMA=y
# CONFIG_VIRTIO_MENU is not set
# CONFIG_VHOST_MENU is not set
CONFIG_EXTCON=y
CONFIG_EXTCON_SM5502=y
CONFIG_IIO=y
CONFIG_BMA180=y
CONFIG_IIO_ST_ACCEL_3AXIS=y
CONFIG_PWM=y
CONFIG_PWM_SPRD_SC8830=y
CONFIG_EXT4_FS=y
# CONFIG_DNOTIFY is not set
CONFIG_VFAT_FS=y
CONFIG_EXFAT_FS=y
CONFIG_TMPFS=y
CONFIG_PSTORE=y
CONFIG_PSTORE_CONSOLE=y
CONFIG_PSTORE_PMSG=y
CONFIG_PSTORE_RAM=y
CONFIG_NLS_CODEPAGE_437=y
CONFIG_NLS_ISO8859_1=y
CONFIG_CRYPTO_ADIANTUM=y
CONFIG_DMA_CMA=y
CONFIG_FONTS=y
CONFIG_FONT_8x8=y
CONFIG_FONT_8x16=y
CONFIG_FONT_TER16x32=y
CONFIG_PRINTK_TIME=y
# CONFIG_SYMBOLIC_ERRNAME is not set
# CONFIG_SECTION_MISMATCH_WARN_ONLY is not set
CONFIG_DEBUG_FS=y
# CONFIG_RUNTIME_TESTING_MENU is not set
```
